## CMakeLists.txt
```
cmake_minimum_required(VERSION 3.8.2)

set(BOARD nrf52_pca10040)
include($ENV{ZEPHYR_BASE}/cmake/app/boilerplate.cmake NO_POLICY_SCOPE)
project(c_code)

# Generate version file
include(build.version.cmake NO_POLICY_SCOPE)

# Schedule a new version file generation after every build
add_custom_command(
    TARGET app
    POST_BUILD
    COMMAND "${CMAKE_COMMAND}"
    -DPROJECT_SOURCE_DIR=${PROJECT_SOURCE_DIR}
    -DPROJECT_BINARY_DIR=${PROJECT_BINARY_DIR}
    -P ${PROJECT_SOURCE_DIR}/build.version.cmake
    )

list(APPEND HEADERS
    "${PROJECT_BINARY_DIR}/include/generated"
    "${PROJECT_BINARY_DIR}/zephyr/include/generated"
    "${PROJECT_SOURCE_DIR}/include"
    )

list(APPEND SOURCES
    "${PROJECT_SOURCE_DIR}/src/ic_version.c"
    "${PROJECT_SOURCE_DIR}/src/leds_pwm.c"
    "${PROJECT_SOURCE_DIR}/src/leds.c"
    "${PROJECT_SOURCE_DIR}/src/main.c"
    )

include_directories(${HEADERS})
target_sources(app PRIVATE ${SOURCES})
```

## prj.conf
```kconfig
CONFIG_PWM=y
CONFIG_GPIO=y
CONFIG_SYS_LOG=y
CONFIG_SYS_LOG_DEFAULT_LEVEL=4
CONFIG_SYS_LOG_SHOW_COLOR=y
```

## src/main.c
```c
/**
 * @file main.c
 * @author your name (you@domain.com)
 * @brief
 * @version 0.1
 * @date 2018-12-25
 *
 * @copyright Copyright (c) 2018
 *
 */

#include "leds.h"
#include "leds_pwm.h"
#include "version.h"

#define SLEEP_TIME 250
#define PERIOD 20000
#define STEP 1000

leds_pwm_device_t pwm_device_1 = {0};
leds_pwm_device_t pwm_device_2 = {0};
leds_device_t leds_device_3    = {0};
leds_device_t leds_device_4    = {0};

int configure_board()
{
    int err;
    err = leds_pwm_init_device(&pwm_device_1, PWM_DRIVER, PWM_CHANNEL0, PERIOD);
    if (err) {
        printk("error initiating leds_pwm_device\n");
        return err;
    }

    err = leds_pwm_init_device(&pwm_device_2, PWM_DRIVER, PWM_CHANNEL1, PERIOD);
    if (err) {
        printk("error initiating leds_pwm_device\n");
        return err;
    }

    leds_init_device(&leds_device_3);
    leds_init_device(&leds_device_4);

    leds_configure(&leds_device_3, LED2);
    leds_configure(&leds_device_4, LED3);

    return 0;
}

void main(void)
{
    printk("Firmware version: %d.%d.%d\n", version_get_major(), version_get_minor(),
           version_get_build());
    u32_t time = k_uptime_get();
    u32_t end_time;

    int err;
    err = configure_board();
    if (err) {
        return;
    }
    u16_t pulse = 0;
    u8_t end    = 0;
    int cnt     = 0;
    int onoff   = 1;
    leds_pwm_change_pulse(&pwm_device_1, pulse);
    leds_pwm_change_pulse(&pwm_device_2, PERIOD - pulse);

    printk("Starting test\n");
    while (1) {
        leds_pwm_change_pulse(&pwm_device_1, pulse);
        leds_pwm_change_pulse(&pwm_device_2, PERIOD - pulse);
        leds_pwm_set_pulse(&pwm_device_1);
        leds_pwm_set_pulse(&pwm_device_2);
        if (cnt > 20000) {
            if (end) {
                end_time = k_uptime_get();
                break;
            }
            end   = 1;
            cnt   = 0;
            onoff = 1;
            pulse = 0;
        } else {
            pulse++;
            // printk("%d\n", pulse);
        }

        if (cnt == onoff * 100) {
            if (onoff % 2) {
                leds_turn_on_led(&leds_device_3);
                leds_turn_on_led(&leds_device_4);
            } else {
                leds_turn_off_led(&leds_device_3);
                leds_turn_off_led(&leds_device_4);
            }
            onoff++;
        }
        cnt++;
    }
    printk("Duration: %d milisec\n", end_time - time);
    printk("Finishing test\n");
}
```

## include/leds.h
```c
/**!
 * @file leds.h
 * @author Geymerson Ramos (geymerson@ic.ufal.br)
 * @brief
 * @version 0.1
 * @date 2018-12-15
 *
 * @copyright Copyright (c) IC 2018
 *
 */
#ifndef _IC_LEDS_H_
#define _IC_LEDS_H_

#include <device.h>
#include <gpio.h>
#include <logging/sys_log.h>
#include <zephyr/types.h>

#define LOW 1
#define HIGH 0

// Configure LED GPIO communication port
#define LED_PORT LED0_GPIO_CONTROLLER

// Configure LED GPIO PIN
#define LED0 LED0_GPIO_PIN
#define LED1 LED1_GPIO_PIN
#define LED2 LED2_GPIO_PIN
#define LED3 LED3_GPIO_PIN


typedef struct {
    struct device *device;
    u8_t initiated;
    u8_t state;
    u32_t led_pin;
} leds_device_t;


/**
 * @brief initiate buttons device
 *
 * This function configures the leds' device communication port.
 * If the device was not initialized, no other function can be called
 *
 * @param leds_device
 * @ret 0 if the communication was successffuly initialized, otherwise return an error
 */
int leds_init_device(leds_device_t *leds_device);

/**
 * @brief Checks if led_pin_mask is a valid led pin number
 *
 * @param leds_device
 * @ret 1 if the led_pin_mask is a valid value, otherwise return 0
 */
int leds_valid_pin_mask(u32_t led_pin_mask);


/**
 * @brief configures all the leds pins
 *
 * This function configures the leds' as input or output, active if HIGH or LOW, etc
 *
 * @param leds_device
 */
int leds_configure(leds_device_t *leds_device, u32_t led_pin);


/**
 * @brief Turn on the specific led with pin address value = led_pin_mask
 *
 * @param leds_device
 * @param led_pin_mask
 */
int leds_turn_on_led(leds_device_t *leds_device);

/**
 * @brief Turn off the specific led with pin address value = led_pin_mask
 *
 * @param leds_device
 * @param led_pin_mask
 */
int leds_turn_off_led(leds_device_t *leds_device);

#endif  // _IC_LEDS_H_
```

## include/leds_pwm.h
```c
/**
 * @file leds_pwm.h
 * @author your name (you@domain.com)
 * @brief
 * @version 0.1
 * @date 2019-01-04
 *
 * @copyright Copyright (c) 2019
 *
 */

#ifndef _IC_LEDS_PWM_H_
#define _IC_LEDS_PWM_H_

#include <device.h>
#include <gpio.h>
#include <logging/sys_log.h>
#include <pwm.h>
#include <zephyr/types.h>

#define PWM_DRIVER CONFIG_PWM_NRF5_SW_0_DEV_NAME

#define PWM_CHANNEL0 LED0_GPIO_PIN
#define PWM_CHANNEL1 LED1_GPIO_PIN
#define PWM_CHANNEL2 LED2_GPIO_PIN
#define PWM_CHANNEL3 LED3_GPIO_PIN

typedef struct {
    struct device *device;
    u8_t pin;
    u16_t pulse_width;
    u16_t period;
    u8_t state;
    u8_t initiated;
} leds_pwm_device_t;

int leds_pwm_init_device(leds_pwm_device_t *leds_pwm_device, char *pwm_driver, u8_t pin,
                         u16_t period);

int leds_pwm_valid_pin_mask(u8_t pin);

int leds_pwm_turn_led_on(leds_pwm_device_t *leds_pwm_device);

int leds_pwm_turn_led_off(leds_pwm_device_t *leds_pwm_device);

int leds_pwm_change_pulse(leds_pwm_device_t *leds_pwm_device, u16_t pulse_width);

int leds_pwm_set_pulse(leds_pwm_device_t *leds_pwm_device);

#endif  // _IC_LEDS_PWM_H_
```

## src/leds.c
```c
/**
 * @file leds.c
 * @Lucas Peixoto(lpdac@ic.ufal.br)
 * @brief
 * @version 0.1
 * @date 2018-12-17
 *
 * @copyright Copyright (c) 2018
 *
 */
#include "leds.h"


int leds_init_device(leds_device_t *leds_device)
{
    if (leds_device->initiated != 0) {
        return -EBUSY;
    }
    struct device *led_dev;
    led_dev                = device_get_binding(LED_PORT);
    leds_device->device    = led_dev;
    leds_device->initiated = 1;
    return 0;
}

int leds_configure(leds_device_t *leds_device, u32_t led_pin)
{
    if (leds_device->initiated != 1) {
        return -ENODEV;
    }

    gpio_pin_configure(leds_device->device, led_pin,
                       GPIO_DIR_OUT | GPIO_PUD_PULL_UP | GPIO_INT_ACTIVE_HIGH);
    leds_device->state   = HIGH;
    leds_device->led_pin = led_pin;

    return 0;
}

int leds_valid_pin_mask(u32_t led_pin_mask)
{
    if (led_pin_mask == LED0 || led_pin_mask == LED1 || led_pin_mask == LED2
        || led_pin_mask == LED3) {
        return 1;
    }
    return 0;
}

int leds_turn_on_led(leds_device_t *leds_device)
{
    if (leds_device->initiated != 1) {
        return -ENODEV;
    }

    leds_device->state = HIGH;
    gpio_pin_write(leds_device->device, leds_device->led_pin, HIGH);
    return 0;
}

int leds_turn_off_led(leds_device_t *leds_device)
{
    if (leds_device->initiated != 1) {
        return -ENODEV;
    }

    leds_device->state = LOW;
    gpio_pin_write(leds_device->device, leds_device->led_pin, LOW);
    return 0;
}
```

## src/leds_pwm.c
```c
/**
 * @file leds.c
 * @Lucas Peixoto(lpdac@ic.ufal.br)
 * @brief
 * @version 0.1
 * @date 2018-12-17
 *
 * @copyright Copyright (c) 2018
 *
 */
#include "leds_pwm.h"


int leds_pwm_init_device(leds_pwm_device_t *leds_pwm_device, char *pwm_driver, u8_t pin,
                         u16_t period)
{
    if (leds_pwm_device->initiated) {
        return -EBUSY;
    }

    if (leds_pwm_valid_pin_mask(pin)) {
        return -EINVAL;
    }

    struct device *led_pwm_dev;

    led_pwm_dev = device_get_binding(pwm_driver);

    if (!led_pwm_dev) {
        printk("Cannot find %s!\n", pwm_driver);
        return -EINVAL;
    }
    leds_pwm_device->pin         = pin;
    leds_pwm_device->period      = period;
    leds_pwm_device->initiated   = 1;
    leds_pwm_device->state       = 1;
    leds_pwm_device->pulse_width = 0;
    leds_pwm_device->device      = led_pwm_dev;

    return 0;
}

int leds_pwm_valid_pin_mask(u8_t pin)
{
    if (pin != PWM_CHANNEL0 && pin != PWM_CHANNEL1 && pin != PWM_CHANNEL2 && pin != PWM_CHANNEL3) {
        return -EINVAL;
    }
    return 0;
}

int leds_pwm_turn_led_on(leds_pwm_device_t *leds_pwm_device)
{
    if (!leds_pwm_device->initiated) {
        return -ENODEV;
    }

    if (leds_pwm_device->state) {
        return -EINVAL;
    }

    leds_pwm_device->state = 1;

    return 0;
}

int leds_pwm_turn_led_off(leds_pwm_device_t *leds_pwm_device)
{
    if (!leds_pwm_device->initiated) {
        return -ENODEV;
    }

    if (!leds_pwm_device->state) {
        return -EINVAL;
    }

    leds_pwm_device->state = 0;

    return 0;
}


int leds_pwm_change_pulse(leds_pwm_device_t *leds_pwm_device, u16_t pulse_width)
{
    if (!leds_pwm_device->initiated) {
        return -ENODEV;
    }

    if (pulse_width > leds_pwm_device->period || pulse_width < 0) {
        return -EINVAL;
    }

    leds_pwm_device->pulse_width = pulse_width;

    return 0;
}

int leds_pwm_set_pulse(leds_pwm_device_t *leds_pwm_device)
{
    if (!leds_pwm_device->initiated) {
        return -ENODEV;
    }

    if (leds_pwm_device->state) {
        int err = pwm_pin_set_usec(leds_pwm_device->device, leds_pwm_device->pin,
                                   leds_pwm_device->period, leds_pwm_device->pulse_width);
        if (err) {
            printk("PWM pin set fails\n");
            return err;
        }
    } else {
        int err = pwm_pin_set_usec(leds_pwm_device->device, leds_pwm_device->pin,
                                   leds_pwm_device->period, leds_pwm_device->period);
        if (err) {
            printk("PWM pin set fails\n");
            return err;
        }
    }
    return 0;
}
```
