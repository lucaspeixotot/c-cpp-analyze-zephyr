## CMakeLists.txt
```
cmake_minimum_required(VERSION 3.8.2)

set(BOARD nrf52_pca10040)
include($ENV{ZEPHYR_BASE}/cmake/app/boilerplate.cmake NO_POLICY_SCOPE)
project(c_code)

# Generate version file
include(build.version.cmake NO_POLICY_SCOPE)

# Schedule a new version file generation after every build
add_custom_command(
    TARGET app
    POST_BUILD
    COMMAND "${CMAKE_COMMAND}"
    -DPROJECT_SOURCE_DIR=${PROJECT_SOURCE_DIR}
    -DPROJECT_BINARY_DIR=${PROJECT_BINARY_DIR}
    -P ${PROJECT_SOURCE_DIR}/build.version.cmake
    )

list(APPEND HEADERS
    "${PROJECT_BINARY_DIR}/include/generated"
    "${PROJECT_BINARY_DIR}/zephyr/include/generated"
    "${PROJECT_SOURCE_DIR}/include"
    )

list(APPEND SOURCES
    "${PROJECT_SOURCE_DIR}/src/ic_version.c"
    "${PROJECT_SOURCE_DIR}/src/main.cpp"
    "${PROJECT_SOURCE_DIR}/src/led_pwm.cpp"
    )

include_directories(${HEADERS})
target_sources(app PRIVATE ${SOURCES})
```

## prj.conf
```kconfig
CONFIG_CPLUSPLUS=y
CONFIG_PWM=y
CONFIG_GPIO=y
CONFIG_SYS_LOG=y
CONFIG_SYS_LOG_DEFAULT_LEVEL=4
CONFIG_SYS_LOG_SHOW_COLOR=y
```

## src/main.cpp
```c
/**
 * @file main.c
 * @author your name (you@domain.com)
 * @brief
 * @version 0.1
 * @date 2018-12-25
 *
 * @copyright Copyright (c) 2018
 *
 */

#include "ic_version.h"
#include "led_pwm.hpp"

#define PERIOD 20000

LedPwm led_pwm;

int configure_board()
{
    int err;
    err = led_pwm.init_device(PWM_DRIVER, PWM_CHANNEL0, PERIOD);
    if (err) {
        return err;
    }
}

void main(void)
{
    printk("Firmware version: %d.%d.%d\n", version_get_major(), version_get_minor(),
           version_get_build());

    u32_t time = k_uptime_get();
    u32_t end_time;

    int err;
    err = configure_board();
    if (err) {
        printk("FAILED configuring board with err %d\n", err);
        return;
    }

    u16_t pulse = 0;
    u8_t end    = 0;
    int cnt     = 0;

    led_pwm.change_pulse(pulse);

    while (1) {
        led_pwm.change_pulse(pulse);
        led_pwm.set_pulse();
        if (cnt > 20000) {
            if (end) {
                end_time = k_uptime_get();
                break;
            }
            end   = 1;
            cnt   = 0;
            pulse = 0;
        } else {
            pulse++;
            printk("%d\n", pulse);
        }

        cnt++;
    }
    printk("Duration: %d milisec\n", end_time - time);
    printk("Finishing test\n");
}
```

## include/led_pwm.hpp
```c
#ifndef _IC_LEDS_PWM_H_
#define _IC_LEDS_PWM_H_

#include <device.h>
#include <gpio.h>
#include <logging/sys_log.h>
#include <pwm.h>
#include <zephyr/types.h>

#define PWM_DRIVER CONFIG_PWM_NRF5_SW_0_DEV_NAME

#define PWM_CHANNEL0 LED0_GPIO_PIN
#define PWM_CHANNEL1 LED1_GPIO_PIN
#define PWM_CHANNEL2 LED2_GPIO_PIN
#define PWM_CHANNEL3 LED3_GPIO_PIN


class LedPwm
{
   public:
    LedPwm();
    int init_device(char *pwm_driver, u8_t pin, u16_t period);
    int turn_led_on();
    int turn_led_off();
    int change_pulse(u16_t pulse_width);
    int set_pulse();

   private:
    struct device *device;
    u8_t pin;
    u16_t pulse_width;
    u16_t period;
    u8_t state;
    u8_t initiated;
};


#endif
```

## src/led_pwm.cpp
```c
#include "led_pwm.hpp"

int led_valid_pin_mask(u8_t pin)
{
    if (pin != PWM_CHANNEL0 && pin != PWM_CHANNEL1 && pin != PWM_CHANNEL2 && pin != PWM_CHANNEL3) {
        return -EINVAL;
    }
    return 0;
}

LedPwm::LedPwm()
{
}

int LedPwm::init_device(char *pwm_driver, u8_t pin, u16_t period)
{
    if (this->initiated) {
        return -EBUSY;
    }

    if (led_valid_pin_mask(pin)) {
        return -EINVAL;
    }

    struct device *led_pwm_dev;

    led_pwm_dev = device_get_binding(pwm_driver);

    if (!led_pwm_dev) {
        printk("Cannot find %s!\n", pwm_driver);
        return -EINVAL;
    }
    this->pin         = pin;
    this->period      = period;
    this->initiated   = 1;
    this->state       = 1;
    this->pulse_width = 0;
    this->device      = led_pwm_dev;

    return 0;
}


int LedPwm::turn_led_on()
{
    if (!this->initiated) {
        return -ENODEV;
    }

    this->state = 1;

    return 0;
}

int LedPwm::turn_led_off()
{
    if (!this->initiated) {
        return -ENODEV;
    }

    this->state = 0;

    return 0;
}

int LedPwm::change_pulse(u16_t pulse_width)
{
    if (!this->initiated) {
        return -ENODEV;
    }

    if (pulse_width > this->period || pulse_width < 0) {
        return -EINVAL;
    }

    this->pulse_width = pulse_width;

    return 0;
}

int LedPwm::set_pulse()
{
    if (!this->initiated) {
        return -ENODEV;
    }

    if (this->state) {
        int err = pwm_pin_set_usec(this->device, this->pin, this->period, this->pulse_width);
        if (err) {
            printk("PWM pin set fails\n");
            return err;
        }
    } else {
        int err = pwm_pin_set_usec(this->device, this->pin, this->period, this->period);
        if (err) {
            printk("PWM pin set fails\n");
            return err;
        }
    }
    return 0;
}
```
